## arch/arm/mach-tmpa9xx/Kconfig
```kconfig
# SPDX-License-Identifier: GPL-2.0+

if ARCH_TMPA9XX
config SYS_SOC
	default "tmpa9xx"
config TARGET_BRAIN_GEN1
	bool "Sharp Brain first generation"
source "board/sharp/brain-gen1/Kconfig"
endif
```

## board/sharp/brain-gen1/Kconfig
```kconfig
# SPDX-License-Identifier: GPL-2.0+
if TARGET_BRAIN_GEN1
config SYS_BOARD
	default "brain-gen1"
config SYS_VENDOR
	default "sharp"
config SYS_CONFIG_NAME
	default "brain-gen1"
endif
```

## board/sharp/brain-gen1/brain-gen1.its
```
/* SPDX-License-Identifier: GPL-2.0+ */
/*
 * Sharp Brain Gen1 Linux FIT image description.
 */
/dts-v1/;

/ {
	description = "Sharp Brain Gen1 Linux";
	#address-cells = <1>;

	images {
		kernel {
			description = "Linux zImage";
			data = /incbin/("zImage");
			type = "kernel";
			arch = "arm";
			os = "linux";
			compression = "none";
			load = <0x40008000>;
			entry = <0x40008000>;
			hash {
				algo = "sha256";
			};
		};

		fdt {
			description = "Sharp Brain Gen1 device tree";
			data = /incbin/("sharp-brain-gen1.dtb");
			type = "flat_dt";
			arch = "arm";
			compression = "none";
			load = <0x41100000>;
			hash {
				algo = "sha256";
			};
		};
	};

	configurations {
		default = "conf";
		conf {
			description = "Sharp Brain Gen1";
			kernel = "kernel";
			fdt = "fdt";
		};
	};
};
```

## configs/brain_gen1_defconfig
```kconfig
CONFIG_ARM=y
CONFIG_ARCH_TMPA9XX=y
CONFIG_SYS_TEXT_BASE=0x43f00000
CONFIG_TARGET_BRAIN_GEN1=y
CONFIG_BOARD_EARLY_INIT_F=y
CONFIG_NR_DRAM_BANKS=1
CONFIG_ENV_SIZE=0x2000
CONFIG_SKIP_LOWLEVEL_INIT=y
CONFIG_BOOTDELAY=2
CONFIG_USE_BOOTARGS=y
CONFIG_BOOTARGS="console=ttyAMA0,115200n8 earlycon=pl011,mmio32,0xf2000000 earlyprintk ignore_loglevel loglevel=8"
# CONFIG_USE_BOOTCOMMAND is not set
CONFIG_VIDEO=y
CONFIG_VIDEO_TMPA9XX=y
CONFIG_CFB_CONSOLE=y
CONFIG_VGA_AS_SINGLE_DEVICE=y
CONFIG_CONSOLE_MUX=y
CONFIG_SYS_CONSOLE_IS_IN_ENV=y
# CONFIG_DISPLAY_CPUINFO is not set
# CONFIG_DISPLAY_BOARDINFO is not set
CONFIG_HUSH_PARSER=y
CONFIG_SYS_PROMPT="Brain Gen1 # "
CONFIG_CMD_BOOTZ=y
CONFIG_CMD_CACHE=y
CONFIG_CMD_FASTBOOT=y
# CONFIG_CMD_FLASH is not set
# CONFIG_CMD_IMLS is not set
# CONFIG_CMD_NET is not set
# CONFIG_CMD_NFS is not set
CONFIG_SYS_RELOC_GD_ENV_ADDR=y
CONFIG_CMD_MMC=y
CONFIG_CMD_FAT=y
CONFIG_CMD_EXT4=y
CONFIG_MMC=y
# CONFIG_MMC_WRITE is not set
CONFIG_SH_SDHI=y
CONFIG_BAUDRATE=115200
CONFIG_CONS_INDEX=0
CONFIG_OF_LIBFDT=y
CONFIG_FIT=y
CONFIG_FIT_FULL_CHECK=y
CONFIG_USB=y
CONFIG_USB_GADGET=y
CONFIG_USB_GADGET_MANUFACTURER="U-Boot"
CONFIG_USB_GADGET_VENDOR_NUM=0x0525
CONFIG_USB_GADGET_PRODUCT_NUM=0xa4a5
CONFIG_USB_GADGET_TMPA9XX=y
CONFIG_USB_FUNCTION_FASTBOOT=y
CONFIG_FASTBOOT_BUF_ADDR=0x42000000
CONFIG_FASTBOOT_BUF_SIZE=0x01000000
```
